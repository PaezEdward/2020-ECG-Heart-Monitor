#include <Wire.h>
#include <Adafruit_GFX.h>
#include <Adafruit_SSD1306.h>

#define SCREEN_WIDTH 128 // OLED display width,  in pixels
#define SCREEN_HEIGHT 64 // OLED display height, in pixels

const int ledPin = 2;


//Heart rate sensor realted declarations
int UpperThreshold = 518;
int LowerThreshold = 490;
int reading = 0;
float BPM = 0.0;
bool IgnoreReading = false;
bool FirstPulseDetected = false;
unsigned long FirstPulseTime = 0;
unsigned long SecondPulseTime = 0;
unsigned long PulseInterval = 0;



// declare an SSD1306 display object connected to I2C
Adafruit_SSD1306 oled(SCREEN_WIDTH, SCREEN_HEIGHT, &Wire, -1);

 // 'Sticker heart-128-128', 128x64px
const unsigned char Heart_PAEZ [] PROGMEM = {
  0xff, 0xff, 0xff, 0xff, 0xff, 0xff, 0xff, 0xff, 0xff, 0xff, 0xff, 0xff, 0xff, 0xff, 0xff, 0xff, 
  0xff, 0xff, 0xff, 0xff, 0xff, 0xff, 0xff, 0xff, 0xff, 0xff, 0xff, 0xff, 0xff, 0xff, 0xff, 0xff, 
  0xff, 0xff, 0xff, 0xff, 0xff, 0xff, 0xff, 0xff, 0xff, 0xff, 0xff, 0xff, 0xff, 0xff, 0xff, 0xff, 
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  0xff, 0xff, 0xff, 0xff, 0xff, 0xff, 0xff, 0xff, 0xff, 0xff, 0xff, 0xff, 0xff, 0xff, 0xff, 0xff
};
void setup() {
  pinMode (ledPin, OUTPUT);
  Serial.begin(9600);


  // initialize OLED display with address 0x3C for 128x64
  if (!oled.begin(SSD1306_SWITCHCAPVCC, 0x3C)) {
    Serial.println(F("SSD1306 allocation failed"));
    while (true);
  }
    oled.clearDisplay();
    oled.setTextSize(2);

  delay(2000); // wait for initializing
  oled.setCursor(0, 0);
}

void loop() {

  //Computing BPM
  Serial.println("\nComputing BPM...");
  reading = analogRead(4);
  if(reading > UpperThreshold && IgnoreReading == false)
  {
    if(FirstPulseDetected == false)
    {
      FirstPulseTime = millis();
      FirstPulseDetected = true;
      digitalWrite (ledPin, 1);
    }
    else
    {
      SecondPulseTime = millis();
      PulseInterval = SecondPulseTime - FirstPulseTime;
      FirstPulseTime = SecondPulseTime;
      digitalWrite (ledPin, 0);
    }
    IgnoreReading = true;
  }
  if(reading < LowerThreshold)
  {
    IgnoreReading = false;
  }  
  BPM = (1.0/PulseInterval) * 60.0 * 1000;
  /*Serial.print(reading);
    Serial.print("\t");
    Serial.print(PulseInterval);
    Serial.print("\t");*/
  Serial.print(BPM);
  Serial.println(" BPM");
  oled.clearDisplay();


  oled.setTextColor(WHITE);     // text color
  oled.setCursor(0,50);
  oled.print("BPM:");
  oled.print(BPM);
 
//oled.display();
//  delay(500);
//
//
//
//
//
//  
//  oled.clearDisplay();
//  digitalWrite (ledPin, HIGH);
//
//  // display bitmap
//  oled.drawBitmap(0, 0, Heart_PAEZ, 128, 64, WHITE);
//  oled.display();
//  delay(500);
//
////  // invert display
////  oled.invertDisplay(1);
//  digitalWrite (ledPin, LOW);
//  delay(500);
////  oled.invertDisplay(0);
}
